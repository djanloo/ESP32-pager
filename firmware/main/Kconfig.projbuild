## firmware/main/Kconfig.projbuild
```kconfig
menu "Cercapersone"

    config PAGER_WIFI_SSID
        string "SSID Wi-Fi"
        default "cambiami"

    config PAGER_WIFI_PASSWORD
        string "Password Wi-Fi"
        default "cambiami"

    config PAGER_SERVER_URL
        string "URL WebSocket del server (senza ?name=)"
        default "ws://192.168.1.10:8000/ws"

    config PAGER_DEVICE_NAME
        string "Nome del dispositivo (a-z 0-9 _ -, max 32)"
        default "cercapersone"

    choice PAGER_LED_TYPE
        prompt "Tipo di LED"
        default PAGER_LED_TYPE_GPIO if IDF_TARGET_ESP32
        default PAGER_LED_TYPE_WS2812

        config PAGER_LED_TYPE_WS2812
            bool "LED RGB WS2812"

        config PAGER_LED_TYPE_GPIO
            bool "LED semplice su GPIO (acceso = livello alto)"
    endchoice

    config PAGER_LED_GPIO
        int "GPIO del LED"
        default 2 if IDF_TARGET_ESP32
        default 48

    config PAGER_BUTTON_GPIO
        int "GPIO del pulsante (attivo basso)"
        default 0

endmenu
```
